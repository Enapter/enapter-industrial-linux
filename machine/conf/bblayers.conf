## machine/conf/bblayers.conf
```bitbake
POKY_BBLAYERS_CONF_VERSION = "2"

BBPATH = "${TOPDIR}"
BSPDIR := "${@os.path.abspath(os.path.dirname(d.getVar('FILE', True)) + '/../..')}"
BBFILES ?= ""

BBLAYERS ?= " \
  ${BSPDIR}/meta-enapter-linux \
  ${BSPDIR}/repositories/meta-cloud-services \
  ${BSPDIR}/repositories/meta-enapter/meta-enapter-core \
  ${BSPDIR}/repositories/meta-intel \
  ${BSPDIR}/repositories/meta-openembedded/meta-filesystems \
  ${BSPDIR}/repositories/meta-openembedded/meta-initramfs \
  ${BSPDIR}/repositories/meta-openembedded/meta-networking \
  ${BSPDIR}/repositories/meta-openembedded/meta-oe \
  ${BSPDIR}/repositories/meta-openembedded/meta-perl \
  ${BSPDIR}/repositories/meta-openembedded/meta-python \
  ${BSPDIR}/repositories/meta-openembedded/meta-webserver \
  ${BSPDIR}/repositories/meta-security \
  ${BSPDIR}/repositories/meta-security/meta-integrity \
  ${BSPDIR}/repositories/meta-virtualization \
  ${BSPDIR}/repositories/poky/meta \
  ${BSPDIR}/repositories/poky/meta-poky \
  ${BSPDIR}/repositories/poky/meta-yocto-bsp \
  "
```

## machine/conf/distro/enapter-linux.conf
```bitbake
DISTRO = "enapter-linux"
DISTRO_NAME = "Enapter Linux"
DISTRO_CODENAME = "genapter"
PACKAGE_CLASSES = "package_rpm"
USER_CLASSES = "buildstats"
PATCHRESOLVE = "noop"

MAINTAINER = "Enapter Developers <developers@enapter.com>"

TARGET_VENDOR = "-enapter"

IMAGE_FEATURES[validitems] += "secureboot"
EXTRA_IMAGE_FEATURES += "secureboot"

BB_DANGLINGAPPENDS_WARNONLY = "1"
INITRAMFS_MAXSIZE="655360"

ROOT_HOME = "/root"
VOLATILE_LOG_DIR = "no"
SERIAL_CONSOLES = ""

IMAGE_FS_TOOLS = "\
    btrfs-tools \
    dosfstools \
    e2fsprogs \
    e2fsprogs-e2fsck \
    e2fsprogs-mke2fs \
    e2fsprogs-resize2fs \
    e2fsprogs-tune2fs \
    grub-editenv \
    parted \
    squashfs-tools \
    util-linux \
"

IMAGE_KERNEL_DEPS = "\
    kernel-modules \
    linux-firmware-i915 \
    linux-firmware-ibt \
    linux-firmware-iwlwifi \
    lshw \
    module-init-tools \
    packagegroup-base-wifi \
    pciutils \
    usbutils \
"

IMAGE_ROOTFS_INSTALL_BASE_UTILS = "\
    bash \
    bc \
    bind-utils \
    coreutils \
    file \
    findutils \
    grep \
    gzip \
    inetutils \
    inetutils-ping \
    inetutils-telnet \
    inetutils-tftp \
    inetutils-traceroute \
    iproute2 \
    iproute2-ip \
    iproute2-ss \
    iproute2-tc \
    less \
    net-tools \
    p7zip \
    procps \
    sed \
    shadow-base \
    tar \
    time \
    unzip \
    vim \
    wget \
    which \
"

IMAGE_ROOTFS_INSTALL_CLI_TOOLS = "\
    mosquitto-clients \
    postgresql-client \
"

IMAGE_ROOTFS_INSTALL_CONNECTIVITY = "\
    avahi-daemon \
    avahi-utils \
    bluez5 \
    can-utils \
    can-utils-access \
    can-utils-cantest \
    can-utils-log \
    can-utils-slcan \
    dnsmasq \
    hostapd \
    mobile-broadband-provider-info \
    modemmanager \
    netplan \
    networkmanager \
    networkmanager-nmtui \
    networkmanager-ppp \
    networkmanager-wwan \
    openssh \
"

IMAGE_ROOTFS_INSTALL_CONTAINERS = "\
    crun \
    netavark \
    podman \
"

# podman-compose recipe missed python3-unixadmin and python3-json as dependency
IMAGE_ROOTFS_INSTALL_DEV_TOOLS = "\
    podman-compose \
    python3-unixadmin \
    python3-json \
"

IMAGE_ROOTFS_INSTALL_ENAPTER_OSS_SOFTWARE = "\
    enapter-authorized-ssh-keys-configurator \
    enapter-banner \
    enapter-cron-hook \
    enapter-cron-hook-timer \
    enapter-docker-compose \
    enapter-hardware-init \
    enapter-initscripts \
    enapter-journald-persistence \
    enapter-network-configurator \
    enapter-networkmanager-configurator \
    enapter-password-configurator \
    enapter-podman-prepare \
    enapter-scripts \
    enapter-setup-machine-id \
    enapter-update-manager \
    enapter-update-manager-timer \
    enapter-user \
    enapter-wifi-watchdog \
    enapter-wifi-watchdog-timer \
    monit \
    nginx \
"

IMAGE_ROOTFS_INSTALL_EXTENDED_UTILS = "\
    curl \
    dmidecode \
    efibootmgr \
    elfutils \
    gawk \
    gdb \
    grpcurl \
    htop \
    i2c-tools \
    iotop \
    iptables \
    jq \
    kexec \
    lsof \
    mc \
    mokutil \
    mtr \
    nano \
    netcat \
    nmap \
    screen \
    socat \
    strace \
    sudo-lib \
    sudo-sudo \
    systemd-analyze \
    tcpdump \
    trace-cmd \
"

IMAGE_ROOTFS_INSTALL_OS_SUPPORT = "\
    bash-completion \
    bash-completion-extra \
    systemd-bash-completion \
"

IMAGE_ROOTFS_INSTALL_SYSTEM_DAEMONS = "\
    chrony \
    chronyc \
    cronie \
"

IMAGE_ROOTFS_INSTALL = "\
    ${IMAGE_FS_TOOLS} \
    ${IMAGE_KERNEL_DEPS} \
    ${IMAGE_ROOTFS_INSTALL_BASE_UTILS} \
    ${IMAGE_ROOTFS_INSTALL_CLI_TOOLS} \
    ${IMAGE_ROOTFS_INSTALL_CONNECTIVITY} \
    ${IMAGE_ROOTFS_INSTALL_CONTAINERS} \
    ${IMAGE_ROOTFS_INSTALL_DEV_TOOLS} \
    ${IMAGE_ROOTFS_INSTALL_ENAPTER_OSS_SOFTWARE} \
    ${IMAGE_ROOTFS_INSTALL_EXTENDED_UTILS} \
    ${IMAGE_ROOTFS_INSTALL_OS_SUPPORT} \
    ${IMAGE_ROOTFS_INSTALL_SYSTEM_DAEMONS} \
    "

# this breaks some stuff, like initramfs-framework installs rootfs sub-package by default
# NO_RECOMMENDATIONS = "1"
INIT_MANAGER = "systemd"
VIRTUAL-RUNTIME_dev_manager = "udev"
# busybox is already a default base-utils package
PREFERRED_PROVIDER_virtual/base-utils = "busybox"
VIRTUAL-RUNTIME_base-utils = "busybox"
VIRTUAL-RUNTIME_base-utils-hwclock = "util-linux-hwclock"
VIRTUAL-RUNTIME_syslog = ""
VIRTUAL-RUNTIME_base-utils-syslog = ""

PREFERRED_PROVIDER_virtual/kernel = "linux-yocto"
PREFERRED_VERSION_linux-yocto = "6.6.%"
KERNEL_MODULE_AUTOLOAD:append = " squashfs i2c-dev"

PREFERRED_VERSION_grub = "2.12-rc1"
PREFERRED_VERSION_grub-efi = "2.12-rc1"

GO_LINKSHARED = ""

hostname_pn-base-files = ""

PACKAGECONFIG:remove:pn-systemd = "timesyncd networkd resolved nss-resolve"
PACKAGECONFIG:append:pn-systemd = " pcre2 coredump elfutils"

SYSTEMD_AUTO_ENABLE:sshd = "disable"

DISTRO_FEATURES = "acl ipv4 ipv6 largefile pam usbhost wifi xattr pci vfat seccomp security integrity modsign"

MACHINE_FEATURES:remove = " \
    alsa \
    irda \
    pcmcia \
    phone \
    qvga \
    touchscreen \
    usbgadget \
    "
```

## meta-enapter-linux/conf/layer.conf
```bitbake
BBPATH =. "${LAYERDIR}:"

BBFILES += "${LAYERDIR}/recipes-*/*/*.bb \
            ${LAYERDIR}/recipes-*/*/*.bbappend"

BBFILE_COLLECTIONS += "enapter-linux"
BBFILE_PATTERN_enapter-linux = "^${LAYERDIR}/"
BBFILE_PRIORITY_enapter-linux = "10"

LAYERSERIES_COMPAT_enapter-linux = "scarthgap"

LAYERVERSION_enapter-linux = "1"
```

## meta-enapter-linux/wic/enapter-linux-image.wks
```
part --source rootfs --rootfs-dir=${IMAGE_ROOTFS}/boot --fstype=vfat --label enp-os-usb --active --fixed-size 4G
```
